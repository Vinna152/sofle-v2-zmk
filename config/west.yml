## config/west.yml
```yaml
manifest:
  remotes:
    - name: zmkfirmware
      url-base: https://github.com/zmkfirmware
    - name: vinna152
      url-base: https://github.com/Vinna152
  projects:
    - name: zmk
      remote: zmkfirmware
      revision: main
      import: app/west.yml
    - name: prospector-zmk-module
      remote: vinna152
      revision: 5bbf979e479a786a6ca3f3d650736994f2900af3
  self:
    path: config
```
